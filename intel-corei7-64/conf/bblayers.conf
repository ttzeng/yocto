## intel-corei7-64/conf/bblayers.conf
```bitbake
# POKY_BBLAYERS_CONF_VERSION is increased each time build/conf/bblayers.conf
# changes incompatibly
POKY_BBLAYERS_CONF_VERSION = "2"

BBPATH = "${TOPDIR}"
POKY_PATH = "${TOPDIR}/../poky"
BBFILES ?= ""

BBLAYERS ?= " \
  ${POKY_PATH}/meta \
  ${POKY_PATH}/meta-poky \
  ${POKY_PATH}/meta-yocto-bsp \
  "

# Intel-maintained BSP
BBLAYERS += "${TOPDIR}/../meta-intel"

# Filesystem and networking supports
BBLAYERS += "${TOPDIR}/../meta-openembedded/meta-oe"
BBLAYERS += "${TOPDIR}/../meta-openembedded/meta-filesystems"
BBLAYERS += "${TOPDIR}/../meta-openembedded/meta-python"
BBLAYERS += "${TOPDIR}/../meta-openembedded/meta-networking"

# Ubuntu Snappy support
BBLAYERS += "${TOPDIR}/../meta-snappy"

# Local customization
BBLAYERS += "${TOPDIR}/meta-custom"
```

## intel-quark/conf/bblayers.conf
```bitbake
# POKY_BBLAYERS_CONF_VERSION is increased each time build/conf/bblayers.conf
# changes incompatibly
POKY_BBLAYERS_CONF_VERSION = "2"

BBPATH = "${TOPDIR}"
POKY_PATH = "${TOPDIR}/../poky"
BBFILES ?= ""

BBLAYERS ?= " \
  ${POKY_PATH}/meta \
  ${POKY_PATH}/meta-poky \
  ${POKY_PATH}/meta-yocto-bsp \
  "

# Intel-maintained BSP
BBLAYERS += "${TOPDIR}/../meta-intel"

# Filesystem and networking supports
BBLAYERS += "${TOPDIR}/../meta-openembedded/meta-oe"
BBLAYERS += "${TOPDIR}/../meta-openembedded/meta-filesystems"
BBLAYERS += "${TOPDIR}/../meta-openembedded/meta-python"
BBLAYERS += "${TOPDIR}/../meta-openembedded/meta-networking"

# Ubuntu Snappy support
# The snap utility can only be run on processers with MMX support
# BBLAYERS += "${TOPDIR}/../meta-snappy"
```

## ref-os-edison/conf/bblayers.conf
```bitbake
# LAYER_CONF_VERSION is increased each time build/conf/bblayers.conf
# changes incompatibly
LCONF_VERSION = "1"

BBPATH = "${TOPDIR}"
REFOS_PATH = "${TOPDIR}/../ref-os-iot"
REFKIT_PATH = "${REFOS_PATH}/intel-iot-refkit"
BBFILES ?= ""

# REF-OS layers
REFKIT_LAYERS = "\
  ${REFKIT_PATH}/openembedded-core/meta \
  ${REFKIT_PATH}/openembedded-core/meta-selftest \
  ${REFKIT_PATH}/meta-intel \
  ${REFKIT_PATH}/meta-refkit \
  ${REFKIT_PATH}/meta-oic \
  ${REFKIT_PATH}/meta-iot-web \
  ${REFKIT_PATH}/meta-openembedded/meta-gnome \
  ${REFKIT_PATH}/meta-openembedded/meta-networking \
  ${REFKIT_PATH}/meta-openembedded/meta-oe \
  ${REFKIT_PATH}/meta-openembedded/meta-python \
  ${REFKIT_PATH}/meta-openembedded/meta-xfce \
  ${REFKIT_PATH}/meta-intel-realsense \
  "

BBLAYERS ?= "${REFKIT_LAYERS}"
BBLAYERS_NON_REMOVABLE ?= "${REFKIT_LAYERS}"

REF-OS_LAYERS = "\
  ${REFOS_PATH}/meta-ref-os-iot \
  ${REFOS_PATH}/meta-ref-os-iot/meta-common/meta-qt5 \
  ${REFOS_PATH}/meta-ref-os-iot/meta-common/meta-ros \
  ${REFOS_PATH}/meta-ref-os-iot/meta-common/meta-java \
  ${REFOS_PATH}/meta-ref-os-iot/meta-common/meta-clang \
  ${REFOS_PATH}/meta-ref-os-iot/meta-common/meta-batman \
  ${REFOS_PATH}/meta-ref-os-iot/meta-common/meta-intel-camera \
  ${REFOS_PATH}/meta-ref-os-iot/meta-common/meta-intel-arduino \
"

BBLAYERS += "${REF-OS_LAYERS}"
BBLAYERS_NON_REMOVABLE += "${REF-OS_LAYERS}"

# Extra layers
REF_OS_EXTRA_LAYERS ?= "\
  ${REFOS_PATH}/meta-ref-os-iot/meta-edison \
"

BBLAYERS += "${REF_OS_EXTRA_LAYERS}"
BBLAYERS_NON_REMOVABLE += "${REF_OS_EXTRA_LAYERS}"
```

## refkit-intel-corei7-64/conf/bblayers.conf
```bitbake
# LAYER_CONF_VERSION is increased each time build/conf/bblayers.conf
# changes incompatibly
LCONF_VERSION = "2"

BBPATH = "${TOPDIR}"
REFKIT_ROOT = "${TOPDIR}/../ref-os-iot/intel-iot-refkit"
BBFILES ?= ""

REFKIT_LAYERS = " \
  ${REFKIT_ROOT}/openembedded-core/meta \
  ${REFKIT_ROOT}/openembedded-core/meta-selftest \
  ${REFKIT_ROOT}/meta-intel \
  ${REFKIT_ROOT}/meta-refkit \
  ${REFKIT_ROOT}/meta-oic \
  ${REFKIT_ROOT}/meta-iot-web \
  ${REFKIT_ROOT}/meta-iotqa \
  ${REFKIT_ROOT}/meta-security-isafw \
  ${REFKIT_ROOT}/meta-intel-realsense \
  ${REFKIT_ROOT}/meta-clang \
  "

# REFKIT_LAYERS += "${REFKIT_ROOT}/meta-openembedded/meta-efl"
# REFKIT_LAYERS += "${REFKIT_ROOT}/meta-openembedded/meta-filesystems"
REFKIT_LAYERS += "${REFKIT_ROOT}/meta-openembedded/meta-gnome"
# REFKIT_LAYERS += "${REFKIT_ROOT}/meta-openembedded/meta-gpe"
# REFKIT_LAYERS += "${REFKIT_ROOT}/meta-openembedded/meta-initramfs"
# REFKIT_LAYERS += "${REFKIT_ROOT}/meta-openembedded/meta-multimedia"
REFKIT_LAYERS += "${REFKIT_ROOT}/meta-openembedded/meta-networking"
REFKIT_LAYERS += "${REFKIT_ROOT}/meta-openembedded/meta-oe"
# REFKIT_LAYERS += "${REFKIT_ROOT}/meta-openembedded/meta-perl"
REFKIT_LAYERS += "${REFKIT_ROOT}/meta-openembedded/meta-python"
# REFKIT_LAYERS += "${REFKIT_ROOT}/meta-openembedded/meta-ruby"
# REFKIT_LAYERS += "${REFKIT_ROOT}/meta-openembedded/meta-systemd"
# REFKIT_LAYERS += "${REFKIT_ROOT}/meta-openembedded/meta-webserver"
# REFKIT_LAYERS += "${REFKIT_ROOT}/meta-openembedded/meta-xfce"
# REFKIT_LAYERS += "${REFKIT_ROOT}/meta-openembedded/toolchain-layer"

BBLAYERS ?= "${REFKIT_LAYERS}"

# toaster uses this hint to decide whether it let's the user
# remove a layer from BBLAYERS. All layers which provide something
# that is required to build refkit-image should be listed here.
# We do not really track that, so add all layers also here.
BBLAYERS_NON_REMOVABLE ?= "${REFKIT_LAYERS}"
```
